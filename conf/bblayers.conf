## conf/bblayers.conf
```bitbake
# POKY_BBLAYERS_CONF_VERSION is increased each time build/conf/bblayers.conf
# changes incompatibly
POKY_BBLAYERS_CONF_VERSION = "2"

BBPATH = "${TOPDIR}"
BBFILES ?= ""

BBLAYERS ?= " \
  /home/tom/yocto/poky/meta \
  /home/tom/yocto/poky/meta-poky \
  /home/tom/yocto/poky/meta-yocto-bsp \
  /home/tom/yocto/meta-arm/meta-arm-toolchain \
  /home/tom/yocto/meta-arm/meta-arm \
  /home/tom/yocto/meta-arm/meta-arm-bsp \
  /home/tom/yocto/meta-ti/meta-ti-bsp \
  /home/tom/yocto/meta-ti/meta-ti-extras \
  "
```
